## beaglebone_external/Config.in
```kconfig
menu "VirtuAiles"
	source "$BR2_EXTERNAL/package/vpbus/Config.in"
    source "$BR2_EXTERNAL/package/vpbus_gpiolib/Config.in"
	source "$BR2_EXTERNAL/package/vpbus_test/Config.in"
endmenu
```

## beaglebone_external/configs/virtuailes_beaglebone_defconfig
```kconfig
BR2_arm=y
BR2_cortex_a8=y
BR2_TOOLCHAIN_EXTERNAL=y
BR2_TARGET_GENERIC_HOSTNAME="beaglebone"
BR2_TARGET_GENERIC_ISSUE="Welcome to Buildroot BeagleBone"
BR2_TARGET_GENERIC_ROOT_PASSWD="beaglebone"
BR2_ROOTFS_OVERLAY="$(BR2_EXTERNAL)/board/beaglebone/rootfs-overlay"
BR2_LINUX_KERNEL=y
BR2_LINUX_KERNEL_CUSTOM_VERSION=y
BR2_LINUX_KERNEL_CUSTOM_VERSION_VALUE="4.6"
BR2_LINUX_KERNEL_DEFCONFIG="omap2plus"
BR2_LINUX_KERNEL_DTS_SUPPORT=y
BR2_LINUX_KERNEL_USE_CUSTOM_DTS=y
BR2_LINUX_KERNEL_CUSTOM_DTS_PATH="$(BR2_EXTERNAL)/board/beaglebone/dts/am335x-boneblack-vrt.dts"
BR2_PACKAGE_OPENSSL=y
BR2_PACKAGE_DROPBEAR=y
BR2_PACKAGE_HTOP=y
BR2_PACKAGE_NANO=y
BR2_TARGET_UBOOT=y
BR2_TARGET_UBOOT_BUILD_SYSTEM_KCONFIG=y
BR2_TARGET_UBOOT_BOARD_DEFCONFIG="am335x_boneblack"
BR2_TARGET_UBOOT_FORMAT_IMG=y
BR2_TARGET_UBOOT_SPL=y
BR2_TARGET_UBOOT_SPL_NAME="MLO"
BR2_PACKAGE_VPBUS=y
BR2_PACKAGE_VPBUS_GPIOLIB=y
BR2_PACKAGE_VPBUS_TEST=y
```

## rpi_external/Config.in
```kconfig
menu "VirtuAiles"
	source "$BR2_EXTERNAL_RPI_PATH/package/vpbus/Config.in"
	source "$BR2_EXTERNAL_RPI_PATH/package/vpbus_test/Config.in"
endmenu
```
